/*
 * Generated by MTK SP Drv_CodeGen Version 03.13.6  for MT6753. Copyright MediaTek Inc. (C) 2013.
 * Fri Jun 29 10:50:54 2018
 * Do Not Modify the File.
 */

&rf_clock_buffer_ctrl {
	compatible = "mediatek, rf_clock_buffer";
	buffer1 = <1>;
	buffer2 = <2>;
	buffer3 = <2>;
	buffer4 = <2>;
};
